#include <dt-bindings/led/led.h>

/ {
    left_encoder: encoder_left {
        /delete-property/ resolution;
        steps = <15>;
    };

    right_encoder: encoder_right {
        /delete-property/ resolution;
        steps = <15>;
    };

    sensors {
        triggers-per-rotation = <15>;
    };
};
